## components/control/kconfig
```kconfig
menu "ESP-NOW Control Configuration"

    config ESPNOW_CONTROL_AUTO_CHANNEL_SENDING
        bool "Auto control the channel of ESP-NOW package sending"
        default n
        help
            The channel sequence used for ESP-NOW package sending is [1, 6, 11, 1, 6, 11, 2, 3, 4, 5, 7, 8, 9, 10, 12, 13] by default.

    config ESPNOW_CONTROL_RETRANSMISSION_TIMES
        int "Retransmission times when sending an ESP-NOW package from the saved channel"
        range 1 15
        depends on ESPNOW_CONTROL_AUTO_CHANNEL_SENDING
        default 5
        help
            The ESP-NOW package will be sent on the saved channel for this retransmission times, then try the auto channel sending.

    config ESPNOW_CONTROL_AUTO_CHANNEL_FORWARD
        bool "Auto control ESP-NOW package forwarding on different channels"
        depends on ESPNOW_CONTROL_AUTO_CHANNEL_SENDING
        default n
        help
            The ESP-NOW package will be forwarded on different channels.

    config ESPNOW_CONTROL_FORWARD_TTL
        int "The max number of hops when forward data"
        range 1 31
        depends on ESPNOW_CONTROL_AUTO_CHANNEL_SENDING
        default 10
        help
            The ESP-NOW package will be forward when the number of hops in data transfer is not zero.

    config ESPNOW_CONTROL_FORWARD_RSSI
        int "The worst signal of the hop when forward data"
        range -70 -30
        depends on ESPNOW_CONTROL_AUTO_CHANNEL_SENDING
        default -55
        help
            The ESP-NOW package will not be forward when the data packet signal received by the receiving device is lower than the value.

endmenu
```

## components/debug/Kconfig
```kconfig
menu "ESP-NOW Debug Configuration" 
    menu "Debug console Configuration"
        config ESPNOW_STORE_HISTORY
            bool "Store command history in flash"
            default y
            help
                Linenoise line editing library provides functions to save and load
                command history. If this option is enabled, initalizes a FAT filesystem
                and uses it to store command history.
    endmenu

    menu "Debug Log Configuration"
        config ESPNOW_DEBUG_LOG_PARTITION_LABEL_DATA
            string "The partition label used to store log info"
            default "log_info"
            help
                Store log info partition label.
            
        config ESPNOW_DEBUG_LOG_PARTITION_LABEL_NVS
            string "The partition lable used to store log status"
            default "log_status"
            help
                Store log status partition label.

        config ESPNOW_DEBUG_LOG_FILE_MAX_SIZE
            int "The file size of the log"
            range 8196 131072
            default 65536
            help
                The file size of the log

        config ESPNOW_DEBUG_LOG_PARTITION_OFFSET
            int "Offset of the log information in partition"
            range 0 524288
            default 0
            help
                Offset of the log information partition

        config ESPNOW_DEBUG_LOG_PRINTF_ENABLE
            bool "Output the `printf` information of the espnow module"
            default n
            help
                Output the `printf` information of the espnow module
    endmenu

    choice ESPNOW_DEBUG_CONSOLE_UART_NUM
        prompt "UART for console input"
        default ESPNOW_DEBUG_CONSOLE_UART_NUM_0
        help
            UART to be selected for serial console.

        config ESPNOW_DEBUG_CONSOLE_UART_NUM_0
            bool "UART0"
        config ESPNOW_DEBUG_CONSOLE_UART_NUM_1
            bool "UART1"
    endchoice

    config ESPNOW_DEBUG_CONSOLE_UART_NUM
        int
        default 0 if ESPNOW_DEBUG_CONSOLE_UART_NUM_0
        default 1 if ESPNOW_DEBUG_CONSOLE_UART_NUM_1
endmenu
```

## components/espnow/Kconfig
```kconfig
menu "ESP-NOW Light Sleep Configuration"

    config ESPNOW_LIGHT_SLEEP
        bool "Enter light sleep before sending ESP-NOW package"
        default n
        help
            Since sending an ESP-NOW package needs a lot of power, if the coin cell solution is used, it needs some time to charge the electric capacity, so let device enter light sleep to wait some time.

    config ESPNOW_LIGHT_SLEEP_DURATION
        int "Light sleep duration"
        range 15 120
        depends on ESPNOW_LIGHT_SLEEP
        default 30
        help
            Set the duration of light sleep, make it enough to charge the electric capacity.

endmenu
```

## components/security/Kconfig
```kconfig
menu "ESP-NOW Security Configuration"

    config ESPNOW_APP_SECURITY
        bool "Secure application data"
        default y
        help
            Enable to secure the application level data.

    config ESPNOW_ALL_SECURITY
        bool "Secure all data"
        default n
        depends on ESPNOW_APP_SECURITY
        help
            Enable to secure all application data.

    config ESPNOW_CONTROL_SECURITY
        bool "Secure control data"
        default n
        depends on ESPNOW_APP_SECURITY && !ESPNOW_ALL_SECURITY
        help
            Enable to secure the control data.

    config ESPNOW_DEBUG_SECURITY
        bool "Secure debug data"
        default n
        depends on ESPNOW_APP_SECURITY && !ESPNOW_ALL_SECURITY
        help
            Enable to secure the debug data.

    config ESPNOW_OTA_SECURITY
        bool "Secure OTA data"
        default n
        depends on ESPNOW_APP_SECURITY && !ESPNOW_ALL_SECURITY
        help
            Enable to secure the OTA data.

    config ESPNOW_PROV_SECURITY
        bool "Secure provisioning data"
        default n
        depends on ESPNOW_APP_SECURITY && !ESPNOW_ALL_SECURITY
        help
            Enable to secure the provisioning data.

endmenu
```

## components/wifi_manager/Kconfig
```kconfig
menu "WIFI_MANAGER"

    config WIFIM_MANAGER_TASK_SIZE
        int "wifi manager task stack size"
        default 2048
        help
            increase the size when stack overflow.

    config WIFIM_MANAGER_TASK_PRIORITY
        int "wifi manager task priority"
        range 0 5
        default 3
        help
            increase the priority as per requirement.
    choice WIFIM_PROV_TRANSPORT
        bool "Provisioning Transport"
        default WIFIM_PROV_TRANSPORT_SOFTAP if IDF_TARGET_ESP32S2
        default WIFIM_PROV_TRANSPORT_BLE
        help
            Wi-Fi provisioning component offers both, SoftAP and BLE transports. Choose any one.

        config WIFIM_PROV_TRANSPORT_BLE
            bool "BLE"
            select BT_ENABLED
            depends on !IDF_TARGET_ESP32S2
        config WIFIM_PROV_TRANSPORT_SOFTAP
            bool "Soft AP"
    endchoice

    config WIFIM_PROV_TRANSPORT
        int
        default 1 if WIFIM_PROV_TRANSPORT_BLE
        default 2 if WIFIM_PROV_TRANSPORT_SOFTAP

    config WIFIM_PROV_MGR_MAX_RETRY_CNT
        int
        default 5
        prompt "Max retries before reseting provisioning state machine"
        help
            Set the Maximum retry to avoid reconnecting to an inexistent AP or if credentials
            are misconfigured. Provisioned credentials are erased and internal state machine
            is reset after this threshold is reached.

    config WIFIM_PROV_SHOW_QR
        bool "Show provisioning QR code"
        default y
        help
            Show the QR code for provisioning.

    config WIFIM_PROV_USING_BLUEDROID
        bool
        depends on (BT_BLUEDROID_ENABLED && (IDF_TARGET_ESP32C3 || IDF_TARGET_ESP32S3))
        select BT_BLE_42_FEATURES_SUPPORTED
        default y
        help
            This enables BLE 4.2 features for Bluedroid.

endmenu
```
